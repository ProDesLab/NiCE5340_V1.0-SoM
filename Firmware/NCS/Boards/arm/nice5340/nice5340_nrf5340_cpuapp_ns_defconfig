## Firmware/NCS/Boards/arm/nice5340/nice5340_nrf5340_cpuapp_ns_defconfig
```kconfig
# SPDX-License-Identifier: Apache-2.0

# Enable MPU
CONFIG_ARM_MPU=y

# Enable hardware stack protection
CONFIG_HW_STACK_PROTECTION=y

# Enable TrustZone-M
CONFIG_ARM_TRUSTZONE_M=y

# This Board implies building Non-Secure firmware
CONFIG_TRUSTED_EXECUTION_NONSECURE=y

# enable GPIO
CONFIG_GPIO=y

# Enable uart driver
CONFIG_SERIAL=y

# enable console
CONFIG_CONSOLE=y
CONFIG_UART_CONSOLE=y
CONFIG_UART_LINE_CTRL=y

# enable USB
CONFIG_USB_DEVICE_STACK=y
CONFIG_USB_DEVICE_PRODUCT="Zephyr CDC ACM"
CONFIG_USB_DEVICE_PID=0x0004
```

## Firmware/bin/NCS/Boards/arm/nice5340/nice5340_nrf5340_cpuapp_defconfig
```kconfig
# SPDX-License-Identifier: Apache-2.0

# Enable MPU
CONFIG_ARM_MPU=y

# Enable hardware stack protection
CONFIG_HW_STACK_PROTECTION=y

# Enable TrustZone-M
CONFIG_ARM_TRUSTZONE_M=y

# enable GPIO
CONFIG_GPIO=y

# Enable uart driver
CONFIG_SERIAL=y

# enable console
CONFIG_CONSOLE=y
CONFIG_UART_CONSOLE=y
CONFIG_UART_LINE_CTRL=y

# enable USB
CONFIG_USB_DEVICE_STACK=y
CONFIG_USB_DEVICE_PRODUCT="Zephyr CDC ACM"
CONFIG_USB_DEVICE_PID=0x0004
CONFIG_USB_DEVICE_INITIALIZE_AT_BOOT=y

# setup clocks
CONFIG_CLOCK_CONTROL_NRF_K32SRC_250PPM=y
CONFIG_SOC_LFXO_CAP_INT_7PF=y
CONFIG_SOC_HFXO_CAP_EXTERNAL=y
```

## Firmware/boards/prodeslab/nice5340_dk/Kconfig.nice5340_dk
```kconfig
# Copyright (c) 2024 Kelly Helmut Lord
# SPDX-License-Identifier: Apache-2.0

config BOARD_NICE5340_DK
	select SOC_NRF5340_CPUAPP_QKAA if BOARD_NICE5340_DK_NRF5340_CPUAPP
	select SOC_NRF5340_CPUAPP_QKAA if BOARD_NICE5340_DK_NRF5340_CPUAPP_NS
	select SOC_NRF5340_CPUNET_QKAA if BOARD_NICE5340_DK_NRF5340_CPUNET
```

## Firmware/boards/prodeslab/nice5340_dk/board.yml
```yaml
board:
  name: nice5340_dk
  vendor: prodeslab
  socs:
  - name: 'nrf5340'
    variants:
    - name: 'ns'
      cpucluster: 'cpuapp'
```

## boards/prodeslab/nice5340/board.yml
```yaml
board:
  name: nice5340
  vendor: prodeslab
  socs:
  - name: 'nrf5340'
    variants:
    - name: 'ns'
      cpucluster: 'cpuapp'
```
